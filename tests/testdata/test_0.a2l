/******************************************************************************
* ASAP2 file: test.a2l
* Sponsored License - for use in support of a program or activity
* sponsored by MathWorks. Not for government, commercial or other
* non-sponsored organizational use.
* Code generation for model "test".
* Model version : 1.1685
* Simulink Coder version : 8.14 (R2018a) 06-Feb-2018
* C source code generated on : Thu Feb 9 16:40:29 2023
* Target selection: MPC5644A.tlc
* Embedded hardware selection: Freescale->MPC55xx
* Code generation objectives: Unspecified
* Validation result: Not run
* (add additional file header information here)
******************************************************************************/ ASAP2_VERSION 1 31
/* Version 1.31 */
/begin PROJECT ProjectName "Project Comment Goes Here"
/begin HEADER "Header Comments go here" /end HEADER
/begin MODULE ModuleName "Module Comment Goes Here"
/begin MOD_PAR "_default_ModParComment"
 /begin MEMORY_SEGMENT _RAMCAL "calibration_ram" DATA RAM INTERN 0x40000000 0x00008000 -1 -1 -1 -1 -1 /end MEMORY_SEGMENT
 /begin MEMORY_SEGMENT _ROMCAL "calibration_rom" DATA FLASH INTERN 0x00FD0000 0x00008000 -1 -1 -1 -1 -1
  /begin IF_DATA ASAP1B_CCP ADDRESS_MAPPING /*orig_adr:*/ 0x00FD0000 /*mapping_adr:*/ 0x40000000 /*length:*/ 0x00008000 /end IF_DATA
 /end MEMORY_SEGMENT
 /begin MEMORY_SEGMENT _RAMMSR "measurement_ram" DATA RAM INTERN 0x40000000 0x00060000 -1 -1 -1 -1 -1 /end MEMORY_SEGMENT
 /begin MEMORY_SEGMENT _CODE "ecu_code" CODE FLASH INTERN 0x01000008 0x1FE000 -1 -1 -1 -1 -1 /end MEMORY_SEGMENT
/end MOD_PAR
/begin IF_DATA ASAP1B_CCP /* Specific definition for CCP */
 /begin SOURCE /* Description of a DAQ */ /* (Data Acquisition List) */ "20ms" 3 20 DISPLAY_IDENTIFIER DAQ2
  /begin QP_BLOB /* The QP-BLOB specify the behavior of */ /* the corresponding DAQ-List */ 1 /* Number of DAQ-list */ LENGTH 0x20 /* Number of ODT's, which can be in- */ /* serted to this DAQ */ CAN_ID_FIXED 0x101 /* CAN-ID for measuring this DAQ */ RASTER 1 /* ECU event-number according to event- */ /* number by the keyword RASTER. */ REDUCTION_ALLOWED /* Data reduction possible */ FIRST_PID 0x3C /* First PID for this DAQ */ /end QP_BLOB
 /end SOURCE
 /begin SOURCE /* Description of a DAQ */ /* (Data Acquisition List) */ "100ms" 3 100 DISPLAY_IDENTIFIER DAQ3
  /begin QP_BLOB /* The QP-BLOB specify the behavior of */ /* the corresponding DAQ-List */ 2 /* Number of DAQ-list */ LENGTH 0x30 /* Number of ODT's, which can be in- */ /* serted to this DAQ */ CAN_ID_FIXED 0x101 /* CAN-ID for measuring this DAQ */ RASTER 2 /* ECU event-number according to event- */ /* number by the keyword RASTER. */ REDUCTION_ALLOWED /* Data reduction possible */ FIRST_PID 0x78 /* First PID for this DAQ */ /end QP_BLOB
 /end SOURCE
 /begin RASTER /* ECU-event specification */ "20ms" /* Name of the ECU-event */ "20ms" /* Shortname */ 1 /* Number of ECU-event */ 3 20 /* Refresh rate = 1 * 125 ms = 125ms */ /* Codes for Scaling units (CSE) look at*/ /* ASAP1b Specification */ /end RASTER
 /begin RASTER /* ECU-event specification */ "100ms" /* Name of the ECU-event */ "100ms" /* Shortname */ 2 /* Number of ECU-event */ 3 100 /* Refresh rate = 1 * 125 ms = 125ms */ /* Codes for Scaling units (CSE) look at*/ /* ASAP1b Specification */ /end RASTER
 /begin SEED_KEY "" "" "" /end SEED_KEY
 /begin CHECKSUM "CRC16.dll" /end CHECKSUM
 /begin TP_BLOB 0x0201 0x0204 0x100 0x101 0x112 1 BAUDRATE 500000 SAMPLE_POINT 70 SAMPLE_RATE 1 BTL_CYCLES 10 SJW 1 SYNC_EDGE SINGLE DAQ_MODE 0 /* 1 = one DAQ per cycle */ CONSISTENCY 1 /* 1 = ODT consistant */ ADDRESS_EXTENSION 0 /* 0 = 1 extension per DAQ (not supported) */ RESUME_SUPPORTED /* necessary for ResumeBit support */ STORE_SUPPORTED /* Not supported */ /begin CHECKSUM_PARAM 0x9001 0xffffffff CHECKSUM_CALCULATION ACTIVE_PAGE /end CHECKSUM_PARAM
  /begin DEFINED_PAGES 0x00 "RAM_PAGE" 0x00 0x40000000 0x00008000 RAM RAM_INIT_BY_ECU /end DEFINED_PAGES
  /*/begin DEFINED_PAGES
0x01
"FLASH"
0x00
0x00FD0000
0x00008000
FLASH
/end DEFINED_PAGES*/ OPTIONAL_CMD 0X5 OPTIONAL_CMD 0X8 OPTIONAL_CMD 0X9 OPTIONAL_CMD 0XC OPTIONAL_CMD 0XD OPTIONAL_CMD 0XE OPTIONAL_CMD 0XF OPTIONAL_CMD 0X10 OPTIONAL_CMD 0X11 OPTIONAL_CMD 0X12 OPTIONAL_CMD 0X13 OPTIONAL_CMD 0X18 OPTIONAL_CMD 0X19 OPTIONAL_CMD 0X20 OPTIONAL_CMD 0X21 OPTIONAL_CMD 0X22 OPTIONAL_CMD 0X23 /end TP_BLOB
/end IF_DATA
/begin MOD_COMMON "" /* Comment */ ALIGNMENT_BYTE 1 ALIGNMENT_WORD 1 ALIGNMENT_LONG 1 ALIGNMENT_FLOAT32_IEEE 1 ALIGNMENT_FLOAT64_IEEE 1 BYTE_ORDER MSB_FIRST DEPOSIT ABSOLUTE /end MOD_COMMON
/begin RECORD_LAYOUT Scalar_BOOLEAN FNC_VALUES 1 UBYTE COLUMN_DIR DIRECT /end RECORD_LAYOUT
/begin RECORD_LAYOUT Scalar_UBYTE FNC_VALUES 1 UBYTE COLUMN_DIR DIRECT /end RECORD_LAYOUT
/begin RECORD_LAYOUT Scalar_BYTE FNC_VALUES 1 SBYTE COLUMN_DIR DIRECT /end RECORD_LAYOUT
/begin RECORD_LAYOUT Scalar_UWORD FNC_VALUES 1 UWORD COLUMN_DIR DIRECT /end RECORD_LAYOUT
/begin RECORD_LAYOUT Scalar_SWORD FNC_VALUES 1 SWORD COLUMN_DIR DIRECT /end RECORD_LAYOUT
/begin RECORD_LAYOUT Scalar_ULONG FNC_VALUES 1 ULONG COLUMN_DIR DIRECT /end RECORD_LAYOUT
/begin RECORD_LAYOUT Scalar_LONG FNC_VALUES 1 SLONG COLUMN_DIR DIRECT /end RECORD_LAYOUT
/begin RECORD_LAYOUT Scalar_FLOAT32_IEEE FNC_VALUES 1 FLOAT32_IEEE COLUMN_DIR DIRECT /end RECORD_LAYOUT
/begin RECORD_LAYOUT Scalar_FLOAT64_IEEE FNC_VALUES 1 FLOAT64_IEEE COLUMN_DIR DIRECT /end RECORD_LAYOUT
/begin RECORD_LAYOUT Lookup1D_BOOLEAN FNC_VALUES 1 UBYTE COLUMN_DIR DIRECT /end RECORD_LAYOUT
/begin RECORD_LAYOUT Lookup1D_X_BOOLEAN AXIS_PTS_X 1 UBYTE INDEX_INCR DIRECT /end RECORD_LAYOUT
/begin RECORD_LAYOUT Lookup1D_BYTE FNC_VALUES 1 SBYTE COLUMN_DIR DIRECT /end RECORD_LAYOUT
/begin RECORD_LAYOUT Lookup1D_X_BYTE AXIS_PTS_X 1 SBYTE INDEX_INCR DIRECT /end RECORD_LAYOUT
/begin RECORD_LAYOUT Lookup1D_UBYTE FNC_VALUES 1 UBYTE COLUMN_DIR DIRECT /end RECORD_LAYOUT
/begin RECORD_LAYOUT Lookup1D_X_UBYTE AXIS_PTS_X 1 UBYTE INDEX_INCR DIRECT /end RECORD_LAYOUT
/begin RECORD_LAYOUT Lookup1D_UWORD FNC_VALUES 1 UWORD COLUMN_DIR DIRECT /end RECORD_LAYOUT
/begin RECORD_LAYOUT Lookup1D_X_UWORD AXIS_PTS_X 1 UWORD INDEX_INCR DIRECT /end RECORD_LAYOUT
/begin RECORD_LAYOUT Lookup1D_WORD FNC_VALUES 1 SWORD COLUMN_DIR DIRECT /end RECORD_LAYOUT
/begin RECORD_LAYOUT Lookup1D_X_WORD AXIS_PTS_X 1 SWORD INDEX_INCR DIRECT /end RECORD_LAYOUT
/begin RECORD_LAYOUT Lookup1D_ULONG FNC_VALUES 1 ULONG COLUMN_DIR DIRECT /end RECORD_LAYOUT
/begin RECORD_LAYOUT Lookup1D_X_ULONG AXIS_PTS_X 1 ULONG INDEX_INCR DIRECT /end RECORD_LAYOUT
/begin RECORD_LAYOUT Lookup1D_SLONG FNC_VALUES 1 SLONG COLUMN_DIR DIRECT /end RECORD_LAYOUT
/begin RECORD_LAYOUT Lookup1D_X_LONG AXIS_PTS_X 1 SLONG INDEX_INCR DIRECT /end RECORD_LAYOUT
/begin RECORD_LAYOUT Lookup1D_FLOAT32_IEEE FNC_VALUES 1 FLOAT32_IEEE COLUMN_DIR DIRECT /end RECORD_LAYOUT
/begin RECORD_LAYOUT Lookup1D_X_FLOAT32_IEEE AXIS_PTS_X 1 FLOAT32_IEEE INDEX_INCR DIRECT /end RECORD_LAYOUT
/begin RECORD_LAYOUT Lookup1D_FLOAT64_IEEE FNC_VALUES 1 FLOAT64_IEEE COLUMN_DIR DIRECT /end RECORD_LAYOUT
/begin RECORD_LAYOUT Lookup1D_X_FLOAT64_IEEE AXIS_PTS_X 1 FLOAT64_IEEE INDEX_INCR DIRECT /end RECORD_LAYOUT
/begin RECORD_LAYOUT Lookup2D_BOOLEAN FNC_VALUES 1 UBYTE COLUMN_DIR DIRECT /end RECORD_LAYOUT
/begin RECORD_LAYOUT Lookup2D_X_BOOLEAN AXIS_PTS_X 1 UBYTE INDEX_INCR DIRECT /end RECORD_LAYOUT
/begin RECORD_LAYOUT Lookup2D_UBYTE FNC_VALUES 1 UBYTE COLUMN_DIR DIRECT /end RECORD_LAYOUT
/begin RECORD_LAYOUT Lookup2D_X_UBYTE AXIS_PTS_X 1 UBYTE INDEX_INCR DIRECT /end RECORD_LAYOUT
/begin RECORD_LAYOUT Lookup2D_BYTE FNC_VALUES 1 SBYTE COLUMN_DIR DIRECT /end RECORD_LAYOUT
/begin RECORD_LAYOUT Lookup2D_X_BYTE AXIS_PTS_X 1 SBYTE INDEX_INCR DIRECT /end RECORD_LAYOUT
/begin RECORD_LAYOUT Lookup2D_UWORD FNC_VALUES 1 UWORD COLUMN_DIR DIRECT /end RECORD_LAYOUT
/begin RECORD_LAYOUT Lookup2D_X_UWORD AXIS_PTS_X 1 UWORD INDEX_INCR DIRECT /end RECORD_LAYOUT
/begin RECORD_LAYOUT Lookup2D_WORD FNC_VALUES 1 SWORD COLUMN_DIR DIRECT /end RECORD_LAYOUT
/begin RECORD_LAYOUT Lookup2D_X_WORD AXIS_PTS_X 1 SWORD INDEX_INCR DIRECT /end RECORD_LAYOUT
/begin RECORD_LAYOUT Lookup2D_ULONG FNC_VALUES 1 ULONG COLUMN_DIR DIRECT /end RECORD_LAYOUT
/begin RECORD_LAYOUT Lookup2D_X_ULONG AXIS_PTS_X 1 ULONG INDEX_INCR DIRECT /end RECORD_LAYOUT
/begin RECORD_LAYOUT Lookup2D_LONG FNC_VALUES 1 SLONG COLUMN_DIR DIRECT /end RECORD_LAYOUT
/begin RECORD_LAYOUT Lookup2D_X_LONG AXIS_PTS_X 1 SLONG INDEX_INCR DIRECT /end RECORD_LAYOUT
/begin RECORD_LAYOUT Lookup2D_FLOAT32_IEEE FNC_VALUES 1 FLOAT32_IEEE COLUMN_DIR DIRECT /end RECORD_LAYOUT
/begin RECORD_LAYOUT Lookup2D_X_FLOAT32_IEEE AXIS_PTS_X 1 FLOAT32_IEEE INDEX_INCR DIRECT /end RECORD_LAYOUT
/begin RECORD_LAYOUT Lookup2D_FLOAT64_IEEE FNC_VALUES 1 FLOAT64_IEEE COLUMN_DIR DIRECT /end RECORD_LAYOUT
/begin RECORD_LAYOUT Lookup2D_X_FLOAT64_IEEE AXIS_PTS_X 1 FLOAT64_IEEE INDEX_INCR DIRECT /end RECORD_LAYOUT
/begin CHARACTERISTIC singleinp "" VALUE 0xfd0010 /* @ECU_Address@singleinp@ */ Scalar_FLOAT32_IEEE 0 test_CM_single -3.4E+38 3.4E+38 /end CHARACTERISTIC
/begin CHARACTERISTIC int32inp "" VALUE 0xfd0008 /* @ECU_Address@int32inp@ */ Scalar_ULONG 0 test_CM_uint32 0 4294967295 /end CHARACTERISTIC
/begin CHARACTERISTIC fixedinp "" VALUE 0xfd0002 /* @ECU_Address@fixedinp@ */ Scalar_SWORD 0 test_CM_int16 -32768 32767 /end CHARACTERISTIC
/begin CHARACTERISTIC int16inp "" VALUE 0xfd0004 /* @ECU_Address@int16inp@ */ Scalar_SWORD 0 test_CM_int16 -32768 32767 /end CHARACTERISTIC
/begin CHARACTERISTIC uint16inp "" VALUE 0xfd0014 /* @ECU_Address@uint16inp@ */ Scalar_UWORD 0 test_CM_uint16 0 65535 /end CHARACTERISTIC
/begin CHARACTERISTIC boolinp "" VALUE 0xfd0000 /* @ECU_Address@boolinp@ */ Scalar_BOOLEAN 0 test_CM_boolean 0 1 /end CHARACTERISTIC
/begin CHARACTERISTIC int8inp "" VALUE 0xfd000c /* @ECU_Address@int8inp@ */ Scalar_BYTE 0 test_CM_int8 -128 127 /end CHARACTERISTIC
/begin CHARACTERISTIC uint8inp "" VALUE 0xfd0016 /* @ECU_Address@uint8inp@ */ Scalar_UBYTE 0 test_CM_uint8 0 255 /end CHARACTERISTIC
/begin MEASUREMENT singleval "" FLOAT32_IEEE test_CM_single 0 0 -3.4E+38 3.4E+38 ECU_ADDRESS 0x40008010 /* @ECU_Address@singleval@ */ /end MEASUREMENT
/begin MEASUREMENT int32val "" SLONG test_CM_int32 0 0 -2147483648 2147483647 ECU_ADDRESS 0x40008008 /* @ECU_Address@int32val@ */ /end MEASUREMENT
/begin MEASUREMENT uint16val "" UWORD test_CM_uint16 0 0 0 65535 ECU_ADDRESS 0x40008014 /* @ECU_Address@uint16val@ */ /end MEASUREMENT
/begin MEASUREMENT int16val "" SWORD test_CM_int16 0 0 -32768 32767 ECU_ADDRESS 0x40008006 /* @ECU_Address@int16val@ */ /end MEASUREMENT
/begin MEASUREMENT fixedval "" SWORD test_CM_int16 0 0 -32768 32767 ECU_ADDRESS 0x40008004 /* @ECU_Address@fixedval@ */ /end MEASUREMENT
/begin MEASUREMENT uint8val "" UBYTE test_CM_uint8 0 0 0 255 ECU_ADDRESS 0x40008016 /* @ECU_Address@uint8val@ */ /end MEASUREMENT
/begin MEASUREMENT int8val "" SBYTE test_CM_int8 0 0 -128 127 ECU_ADDRESS 0x4000800c /* @ECU_Address@int8val@ */ /end MEASUREMENT
/begin MEASUREMENT boolval "" UBYTE test_CM_boolean 0 0 0 1 ECU_ADDRESS 0x40008002 /* @ECU_Address@boolval@ */ /end MEASUREMENT
/begin MEASUREMENT PwrM_flgKeyOnDelay "" UBYTE test_CM_boolean 0 0 0 1 ECU_ADDRESS 0x40008000 /* @ECU_Address@PwrM_flgKeyOnDelay@ */ /end MEASUREMENT
/begin MEASUREMENT PwrM_flgKeyOnRaw "" UBYTE test_CM_boolean 0 0 0 1 ECU_ADDRESS 0x40008001 /* @ECU_Address@PwrM_flgKeyOnRaw@ */ /end MEASUREMENT
/begin COMPU_METHOD test_CM_single "Q = V" RAT_FUNC "%8.6" "" COEFFS 0 1 0 0 0 1 /end COMPU_METHOD
/begin COMPU_METHOD test_CM_uint32 "Q = V" RAT_FUNC "%10.0" "" COEFFS 0 1 0 0 0 1 /end COMPU_METHOD
/begin COMPU_METHOD test_CM_int16 "Q = V" RAT_FUNC "%5.0" "" COEFFS 0 1 0 0 0 1 /end COMPU_METHOD
/begin COMPU_METHOD test_CM_uint16 "Q = V" RAT_FUNC "%5.0" "" COEFFS 0 1 0 0 0 1 /end COMPU_METHOD
/begin COMPU_METHOD test_CM_boolean "Q = V" RAT_FUNC "%1.0" "" COEFFS 0 1 0 0 0 1 /end COMPU_METHOD
/begin COMPU_METHOD test_CM_int8 "Q = V" RAT_FUNC "%3.0" "" COEFFS 0 1 0 0 0 1 /end COMPU_METHOD
/begin COMPU_METHOD test_CM_uint8 "Q = V" RAT_FUNC "%3.0" "" COEFFS 0 1 0 0 0 1 /end COMPU_METHOD
/begin COMPU_METHOD test_CM_int32 "Q = V" RAT_FUNC "%10.0" "" COEFFS 0 1 0 0 0 1 /end COMPU_METHOD
/begin GROUP test "test" /* Root */ ROOT
 /begin SUB_GROUP Root_00__Vehicle_Control_Solution Root_Power_Management_Example /end SUB_GROUP
/end GROUP
/begin GROUP Root_00__Vehicle_Control_Solution "test/00. Vehicle Control Solution"
 /begin SUB_GROUP S1_Read_Calibration S1_Read_Calibration1 S1_Read_Calibration2 S1_Read_Calibration3 S1_Read_Calibration4 S1_Read_Calibration5 S1_Read_Calibration6 S1_Read_Calibration7 /end SUB_GROUP
 /begin REF_MEASUREMENT int32val /end REF_MEASUREMENT
/end GROUP
/begin GROUP Root_Power_Management_Example "test/Power Management Example" /begin SUB_GROUP S5_Power_Off_Management /end SUB_GROUP /end GROUP
/begin GROUP S1_Read_Calibration "test/00. Vehicle Control Solution/Read Calibration" /begin REF_CHARACTERISTIC singleinp /end REF_CHARACTERISTIC /begin REF_MEASUREMENT singleval /end REF_MEASUREMENT /end GROUP
/begin GROUP S1_Read_Calibration1 "test/00. Vehicle Control Solution/Read Calibration1" /begin REF_CHARACTERISTIC int8inp /end REF_CHARACTERISTIC /begin REF_MEASUREMENT int8val /end REF_MEASUREMENT /end GROUP
/begin GROUP S1_Read_Calibration2 "test/00. Vehicle Control Solution/Read Calibration2" /begin REF_CHARACTERISTIC uint8inp /end REF_CHARACTERISTIC /begin REF_MEASUREMENT uint8val /end REF_MEASUREMENT /end GROUP
/begin GROUP S1_Read_Calibration3 "test/00. Vehicle Control Solution/Read Calibration3" /begin REF_CHARACTERISTIC int16inp /end REF_CHARACTERISTIC /begin REF_MEASUREMENT int16val /end REF_MEASUREMENT /end GROUP
/begin GROUP S1_Read_Calibration4 "test/00. Vehicle Control Solution/Read Calibration4" /begin REF_CHARACTERISTIC uint16inp /end REF_CHARACTERISTIC /begin REF_MEASUREMENT uint16val /end REF_MEASUREMENT /end GROUP
/begin GROUP S1_Read_Calibration5 "test/00. Vehicle Control Solution/Read Calibration5" /begin REF_CHARACTERISTIC int32inp /end REF_CHARACTERISTIC /end GROUP
/begin GROUP S1_Read_Calibration6 "test/00. Vehicle Control Solution/Read Calibration6" /begin REF_CHARACTERISTIC boolinp /end REF_CHARACTERISTIC /begin REF_MEASUREMENT boolval /end REF_MEASUREMENT /end GROUP
/begin GROUP S1_Read_Calibration7 "test/00. Vehicle Control Solution/Read Calibration7" /begin REF_CHARACTERISTIC fixedinp /end REF_CHARACTERISTIC /begin REF_MEASUREMENT fixedval /end REF_MEASUREMENT /end GROUP
/begin GROUP S5_Power_Off_Management "test/Power Management Example/Power Off Management" /begin SUB_GROUP S130_Get_flgKeyOn /end SUB_GROUP /begin REF_MEASUREMENT PwrM_flgKeyOnDelay /end REF_MEASUREMENT /end GROUP
/begin GROUP S130_Get_flgKeyOn "test/Power Management Example/Power Off Management/Get flgKeyOn" /begin REF_MEASUREMENT PwrM_flgKeyOnRaw /end REF_MEASUREMENT /end GROUP
/end MODULE
/end PROJECT
/* (add any file trailer comments here) */
/* EOF test.a2l */
